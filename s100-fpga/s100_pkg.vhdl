-------------------------------------------------------------------------------
-- S-100 (IEEE-696) bus view for the TE0725 S-100 CPU-replacement board.
--
-- The board replaces the MPU-A processor card of an IMSAI 8080. The FPGA is
-- the permanent bus master: it generates the clocks, address, status, strobes
-- and DO, listens to DI, MWRT and the open-collector lines, and talks to the
-- CP-A front panel through the processor data-bus cable.
--
-- Application logic never touches FPGA pins or level-shifter control lines.
-- It sees the bus through two records:
--
--   s100_in_t   everything the FPGA can observe on the bus
--   s100_out_t  everything the FPGA may drive, plus the "drive" requests
--
-- Naming: bus signals that are active low carry the suffix _n and are '0'
-- when asserted, exactly like the asterisk names on the S-100 connector
-- (pWR* -> pwr_n). DO = data out of the bus master, DI = data into the bus
-- master.
--
-- Abbreviations: OC = open collector (wired-OR bus line), DMA = direct memory
-- access, TM = temporary master (a DMA device that takes the bus over),
-- CP-A = the IMSAI front panel board.
-------------------------------------------------------------------------------
library ieee;
use ieee.std_logic_1164.all;

package s100_pkg is

  type s100_in_t is record
    -- address bus A0..A23 (own value in CPU mode, bus value in monitor mode)
    a : std_logic_vector(23 downto 0);

    -- FPGA data port. d follows the 3.3 V data net whenever the FPGA itself
    -- is not driving it (d_valid = '1'). In CPU mode that is DI0..DI7 while
    -- the DI transceiver is on, or the CP-A cable while the front panel
    -- forces data (ssw_dsb_n = '0').
    d       : std_logic_vector(7 downto 0);
    d_valid : std_logic;

    -- status lines (valid for the whole bus cycle)
    sm1   : std_logic;  -- op-code fetch
    sout  : std_logic;  -- output port write
    sinp  : std_logic;  -- input port read
    smemr : std_logic;  -- memory read
    shlta : std_logic;  -- halt acknowledge
    sinta : std_logic;  -- interrupt acknowledge
    swo_n : std_logic;  -- write cycle (active low)

    -- control strobes of the current bus master
    psync    : std_logic;  -- start of bus cycle
    pstval_n : std_logic;  -- status valid (active low); PHI1 on an IMSAI
    pdbin    : std_logic;  -- data bus in strobe (master reads DI)
    pwr_n    : std_logic;  -- write strobe (active low, master writes DO)

    -- processor state lines (always driven by the CPU card)
    phlda : std_logic;  -- hold acknowledge
    phi   : std_logic;  -- master clock (PHI2 on an IMSAI)
    clock : std_logic;  -- 2 MHz reference clock
    pwait : std_logic;  -- processor is in a wait state (IMSAI PWAIT, pin 27)
    pinte : std_logic;  -- interrupts enabled            (IMSAI PINTE, pin 28)

    -- memory write strobe: generated by the IMSAI front panel or, with
    -- solder jumper JP1 closed, by the on-board gate (pWR* and not sOUT)
    mwrt : std_logic;

    -- open-collector lines (wired-OR on the bus, '0' = asserted)
    rdy         : std_logic;  -- slave ready (IMSAI PRDY)
    xrdy        : std_logic;  -- external ready (front panel RUN/STOP, single step)
    int_n       : std_logic;  -- interrupt request
    nmi_n       : std_logic;  -- non-maskable interrupt
    hold_n      : std_logic;  -- bus hold request from a temporary master
    pwrfail_n   : std_logic;  -- power failure warning
    error_n     : std_logic;  -- bus error
    vi_n        : std_logic_vector(7 downto 0);  -- vectored interrupts VI0*..VI7*
    tma_n       : std_logic_vector(3 downto 0);  -- temporary master arbitration TMA0*..TMA3*
    sdsb_n      : std_logic;  -- status disable
    cdsb_n      : std_logic;  -- control disable
    adsb_n      : std_logic;  -- address disable
    dodsb_n     : std_logic;  -- data out disable
    reset_n     : std_logic;  -- reset (front panel RESET switch)
    slave_clr_n : std_logic;  -- slave clear (IMSAI EXT CLR)
    poc_n       : std_logic;  -- power-on clear (driven by this card)
    phantom_n   : std_logic;  -- phantom (memory overlay)
    ssw_dsb_n   : std_logic;  -- IMSAI pin 53: front panel forces data onto the CPU bus
  end record;

  type s100_out_t is record
    -- '1': the push-pull transceivers for address, status and strobes point
    -- towards the bus and the FPGA drives them (CPU / master role).
    -- '0': they point towards the FPGA (bus monitor role).
    -- The processor state lines PHI, CLOCK, pHLDA, PWAIT, PINTE follow the
    -- same direction but stay enabled during DMA.
    master : std_logic;

    -- '1': address, status and strobe transceivers enabled. '0' tri-states
    -- them on the bus (DMA: HOLD/pHLDA, or ADSB*/CDSB*/SDSB*).
    bus_enable : std_logic;

    a                                            : std_logic_vector(23 downto 0);
    sm1, sout, sinp, smemr, shlta, sinta, swo_n  : std_logic;
    psync, pstval_n, pdbin, pwr_n                : std_logic;
    phlda, phi, clock, pwait, pinte              : std_logic;

    -- data path. One 8-bit FPGA port is shared by the DO, DI and CP-A cable
    -- transceivers; main.vhdl makes sure only one source drives it.
    data_master : std_logic;  -- '1': DO transceiver towards the bus, DI transceiver
                              --      towards the FPGA (CPU role). '0': reverse.
    d           : std_logic_vector(7 downto 0);  -- value driven while d_drive = '1'
    d_drive     : std_logic;  -- FPGA drives the data port (write data, status word)
    do_enable   : std_logic;  -- DO transceiver on (CPU role: always, except DODSB*/DMA)
    di_enable   : std_logic;  -- DI transceiver on (CPU role: while reading)

    -- open-collector lines: '1' pulls the bus line low, '0' releases it.
    rdy_pull, xrdy_pull, int_pull, nmi_pull, hold_pull, pwrfail_pull, error_pull : std_logic;
    vi_pull  : std_logic_vector(7 downto 0);
    tma_pull : std_logic_vector(3 downto 0);
    sdsb_pull, cdsb_pull, adsb_pull, dodsb_pull         : std_logic;
    reset_pull, slave_clr_pull, poc_pull, phantom_pull  : std_logic;
  end record;

  -- Passive bus monitor: everything points towards the FPGA, nothing driven.
  constant S100_OUT_IDLE : s100_out_t := (
    master => '0', bus_enable => '1',
    a => (others => '0'),
    sm1 => '0', sout => '0', sinp => '0', smemr => '0', shlta => '0', sinta => '0', swo_n => '1',
    psync => '0', pstval_n => '1', pdbin => '0', pwr_n => '1',
    phlda => '0', phi => '0', clock => '0', pwait => '0', pinte => '0',
    data_master => '0', d => (others => '0'), d_drive => '0', do_enable => '1', di_enable => '0',
    rdy_pull => '0', xrdy_pull => '0', int_pull => '0', nmi_pull => '0',
    hold_pull => '0', pwrfail_pull => '0', error_pull => '0',
    vi_pull => (others => '0'), tma_pull => (others => '0'),
    sdsb_pull => '0', cdsb_pull => '0', adsb_pull => '0', dodsb_pull => '0',
    reset_pull => '0', slave_clr_pull => '0', poc_pull => '0', phantom_pull => '0'
  );

  -- bus cycle types of the master (8080 status word in brackets)
  type s100_cycle_t is (
    CYC_MEM_READ,   -- sMEMR                 (82h; with m1: A2h)
    CYC_MEM_WRITE,  -- sWO*                  (00h)
    CYC_IO_READ,    -- sINP, sWO*            (42h)
    CYC_IO_WRITE,   -- sOUT                  (10h)
    CYC_INT_ACK     -- sINTA, sM1, sWO*      (23h)
  );

end package s100_pkg;
